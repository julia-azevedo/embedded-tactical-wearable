## CMakeLists.txt
```
cmake_minimum_required(VERSION 3.20.0)
find_package(Zephyr REQUIRED HINTS $ENV{ZEPHYR_BASE})
project(tactical_wearable)

# Adicionando todos os novos módulos na fila de compilação
target_sources(app PRIVATE 
    src/main.c 
    src/tatico_events.c 
    src/tatico_settings.c 
    src/tatico_shell.c
    src/tatico_button.c
)
```

## prj.conf
```kconfig
# Ativar sistema de Log
CONFIG_LOG=y
CONFIG_LOG_DEFAULT_LEVEL=3
CONFIG_ZBUS=y
CONFIG_SHELL=y
CONFIG_SHELL_BACKEND_SERIAL=y
CONFIG_SETTINGS=y
CONFIG_SETTINGS_RUNTIME=y
CONFIG_FLASH=y
CONFIG_FLASH_MAP=y
CONFIG_NVS=y
CONFIG_SETTINGS_NVS=y
```

## src/main.c
```c
#include <zephyr/kernel.h>
#include <zephyr/logging/log.h>
#include <zephyr/settings/settings.h>

/* Importa as interfaces dos nossos módulos */
#include "tatico_events.h"
#include "tatico_settings.h"
#include "tatico_button.h"

LOG_MODULE_REGISTER(tatico_main, LOG_LEVEL_INF);

int main(void)
{
    LOG_INF("Iniciando Simulacao do Sistema Tatico Vestivel...");

    /* 1. Inicializa o motor principal do settings no Zephyr */
    settings_subsys_init();
    
    /* 2. Inicializa o NOSSO módulo (que mora lá no tatico_settings.c) */
    tatico_settings_init();
    
    /* 3. Força a leitura da Flash */
    settings_load();

    uint32_t tempo_simulacao = 0;
    bool sinal_botao = false;

    /* Loop principal: Roda a cada 10 milissegundos infinitamente */
    while(1)
    {
        /* --- SCRIPT DE SIMULAÇÃO DE CLIQUES --- */
        
        /* Entre 2s e 2.1s -> Aperta e solta rápido (Clique Curto / Nivel 1) */
        if (tempo_simulacao == 2000) { sinal_botao = true; LOG_DBG("Simulando: Dedo apertou"); }
        if (tempo_simulacao == 2100) { sinal_botao = false; LOG_DBG("Simulando: Dedo soltou"); }

        /* Entre 5s e 5.1s -> Aperta. Entre 5.2s e 5.3s -> Aperta (Clique Duplo / Nivel 2) */
        if (tempo_simulacao == 5000) { sinal_botao = true; }
        if (tempo_simulacao == 5100) { sinal_botao = false; }
        if (tempo_simulacao == 5200) { sinal_botao = true; }
        if (tempo_simulacao == 5300) { sinal_botao = false; }

        /* Entre 9s e 11s -> Segura apertado por 2 segundos (Clique Longo SOS / Nivel 3) */
        if (tempo_simulacao == 9000) { sinal_botao = true; }
        if (tempo_simulacao == 11000) { sinal_botao = false; }

        /* --- FIM DA SIMULAÇÃO --- */

        /* Alimenta o "Cérebro" com o estado atual do botão */
        tatico_button_update(sinal_botao);

        /* Dorme curtinho para não travar a máquina de estados (Polling rate de 100Hz) */
        k_msleep(10); 
        tempo_simulacao += 10;
        
        /* Reinicia o roteiro da simulação a cada 15 segundos */
        if (tempo_simulacao >= 15000) tempo_simulacao = 0;
    }
    
    return 0;
}
```

## src/tatico_button.c
```c
#include <zephyr/kernel.h>
#include <zephyr/logging/log.h>
#include "tatico_button.h"
#include "tatico_events.h"
#include "tatico_settings.h"

LOG_MODULE_REGISTER(tatico_button, LOG_LEVEL_INF);

/* Definição dos Estados possíveis */
typedef enum {
    STATE_IDLE,
    STATE_PRESSED,
    STATE_WAIT_DOUBLE,
    STATE_WAIT_RELEASE
} button_state_t;

/* Variáveis de controle da máquina de estados */
static button_state_t current_state = STATE_IDLE;
static uint32_t state_time = 0;

/* Função auxiliar para publicar no Zbus de forma limpa */
static void disparar_alerta(int nivel)
{
    struct tatico_msg msg;
    msg.nivel_alerta = nivel;
    msg.origem_id = tatico_settings_get_id(); /* Pega o ID salvo na flash */
    
    zbus_chan_pub(&canal_tatico, &msg, K_NO_WAIT);
}

void tatico_button_update(bool is_pressed)
{
    uint32_t now = k_uptime_get_32(); /* Tempo atual do sistema em milissegundos */

    switch (current_state) {
        
        case STATE_IDLE:
            if (is_pressed) {
                current_state = STATE_PRESSED;
                state_time = now; /* Marca a hora exata que apertou */
            }
            break;

        case STATE_PRESSED:
            if (!is_pressed) {
                /* Soltou o botão! Vamos calcular quanto tempo durou */
                uint32_t press_duration = now - state_time;
                
                if (press_duration < 50) {
                    /* DEBOUNCE: Foi rápido demais, menos de 50ms. É ruído elétrico! Ignora. */
                    current_state = STATE_IDLE;
                } 
                else if (press_duration > 1500) {
                    /* CLIQUE LONGO: Mais de 1.5 segundos. É um SOS! */
                    LOG_ERR(">> CLIQUE LONGO DETECTADO! Disparando SOS (Nivel 3) <<");
                    disparar_alerta(3);
                    current_state = STATE_IDLE;
                } 
                else {
                    /* CLIQUE CURTO: Foi um clique normal. 
                       Vamos para o estado de espera para ver se vem um segundo clique! */
                    current_state = STATE_WAIT_DOUBLE;
                    state_time = now; /* Zera o relógio para a espera */
                }
            }
            break;

        case STATE_WAIT_DOUBLE:
            if (is_pressed) {
                /* O soldado apertou de novo antes do tempo acabar! */
                LOG_WRN(">> DUPLO CLIQUE DETECTADO! Disparando Aviso (Nivel 2) <<");
                disparar_alerta(2);
                current_state = STATE_WAIT_RELEASE; /* Trava até ele soltar o dedo */
            } 
            else if ((now - state_time) > 400) {
                /* Passaram-se 400ms e ele não apertou de novo. Era só um clique simples. */
                LOG_INF(">> CLIQUE SIMPLES DETECTADO! Status Normal (Nivel 1) <<");
                disparar_alerta(1);
                current_state = STATE_IDLE;
            }
            break;

        case STATE_WAIT_RELEASE:
            /* Apenas espera o botão voltar para o nível baixo (soltar) para recomeçar */
            if (!is_pressed) {
                current_state = STATE_IDLE;
            }
            break;
    }
}
```

## src/tatico_button.h
```c
#ifndef TATICO_BUTTON_H
#define TATICO_BUTTON_H

#include <stdbool.h>

void tatico_button_update(bool is_pressed);

#endif /* TATICO_BUTTON_H */
```

## src/tatico_events.c
```c
#include <zephyr/kernel.h>
#include <zephyr/logging/log.h>
#include "tatico_events.h" /* Inclui o próprio cabeçalho */

/* Registro do módulo de log para este arquivo */
LOG_MODULE_REGISTER(tatico_events, LOG_LEVEL_INF);

/* Criar o ouvinte (Subscriber) que reage às mensagens */
void listener_tatico_cb(const struct zbus_channel *chan)
{
    /* Extrai a mensagem do canal */
    const struct tatico_msg *msg = zbus_chan_const_msg(chan);

    LOG_WRN("ALERTA CAPTURADO PELO ZBUS! >>>SOLDADO %d com Nivel de alerta: %d <<<", msg->origem_id, msg->nivel_alerta);
}

/* Definir o canal do ZBUS e registrar quem são os Listeners */
ZBUS_LISTENER_DEFINE(listener_tatico, listener_tatico_cb);

ZBUS_CHAN_DEFINE(canal_tatico,                   /* Nome do canal */
                 struct tatico_msg,              /* Tipo de dado da mensagem */
                 NULL, NULL,                     /* Validadores (não utilizados) */
                 ZBUS_OBSERVERS(listener_tatico),/* Quem escutará esse canal */
                 ZBUS_MSG_INIT(0));              /* Valor inicial da mensagem */
```

## src/tatico_events.h
```c
#ifndef TATICO_EVENTS_H
#define TATICO_EVENTS_H

#include <zephyr/zbus/zbus.h>

/* Definir a estrutura da mensagem que irá trafegar no Channel */
struct tatico_msg {
    int nivel_alerta; /* 1 = "Normal", 2 = "Aviso", 3 = "Crítico SOS" */
    int origem_id;    /* Agora a mensagem saberá qual soldado a enviou */
};

/* DECLARA (mas não cria) o canal para que outros arquivos possam publicá-lo */
ZBUS_CHAN_DECLARE(canal_tatico);

#endif /* TATICO_EVENTS_H */
```

## src/tatico_settings.c
```c
#include <zephyr/kernel.h>
#include <zephyr/logging/log.h>
#include <zephyr/settings/settings.h>
#include "tatico_settings.h"

/* Registo do módulo de log exclusivo para a gestão de memória */
LOG_MODULE_REGISTER(tatico_settings, LOG_LEVEL_INF);

/* Variável estática (privada): nenhum outro arquivo consegue alterá-la diretamente */
static int soldado_id = 1;

/* Callback interno de leitura do subsistema Settings */
static int tatico_settings_set(const char *name, size_t len, settings_read_cb read_cb, void *cb_arg)
{
    const char *next;
    
    /* Verifica se a chave que o SO está a carregar é a nossa "soldado_id" */
    if (settings_name_steq(name, "soldado_id", &next) && !next) {
        if (len == sizeof(soldado_id)) {
            /* Lê o valor bruto da memória emulada e atualiza a variável local */
            read_cb(cb_arg, &soldado_id, sizeof(soldado_id));
            LOG_INF("[SETTINGS] ID do Soldado carregado com sucesso da Flash: %d", soldado_id);
            return 0;
        }
    }
    return -ENOENT;
}

/* Estrutura interna que define o grupo "tatico" de configurações */
static struct settings_handler tatico_conf = {
    .name = "tatico",
    .h_set = tatico_settings_set
};

/* IMPLEMENTAÇÃO DAS FUNÇÕES PÚBLICAS */

int tatico_settings_init(void)
{
    /* Regista o nosso handler interno dentro do ecossistema do Zephyr */
    return settings_register(&tatico_conf);
}

int tatico_settings_get_id(void)
{
    return soldado_id;
}

int tatico_settings_save_id(int novo_id)
{
    soldado_id = novo_id;
    /* Guarda o novo valor de forma persistente sob a chave textual "tatico/soldado_id" */
    return settings_save_one("tatico/soldado_id", &soldado_id, sizeof(soldado_id));
}
```

## src/tatico_settings.h
```c
#ifndef TATICO_SETTINGS_H
#define TATICO_SETTINGS_H

/* Inicializa o módulo de configurações e regista o handler no Zephyr */
int tatico_settings_init(void);

/* Função pública para obter o ID do soldado atual (Getter) */
int tatico_settings_get_id(void);

/* Função pública para atualizar e salvar o ID do soldado na flash (Setter) */
int tatico_settings_save_id(int novo_id);

#endif /* TATICO_SETTINGS_H */
```

## src/tatico_shell.c
```c
#include <zephyr/kernel.h>
#include <zephyr/shell/shell.h>
#include <stdlib.h>
#include "tatico_settings.h" /* Importa a interface do módulo de memória */

/* Função que será executada ao acionar o comando no terminal */
static int cmd_set_id(const struct shell *shell, size_t argc, char **argv)
{
    if (argc < 2) {
        shell_print(shell, "Erro: Informe o ID do soldado. Ex: tatico set_id x");
        return -EINVAL;
    }

    int novo_id = atoi(argv[1]);
    shell_print(shell, "Processando... Novo ID solicitado: %d", novo_id);

    /* Chama a interface pública do Módulo de Configurações para salvar */
    int rc = tatico_settings_save_id(novo_id);
    if (rc) {
        shell_print(shell, "Erro ao salvar na memoria flash: %d", rc);
    } else {
        shell_print(shell, "Memoria atualizada com sucesso!");
    }

    return 0;
}

/* Registro do comando no SO. 
   Hierarquia: tatico -> set_id -> [funcao]
*/
SHELL_STATIC_SUBCMD_SET_CREATE(sub_tatico,
    SHELL_CMD(set_id, NULL, "Configura o ID do soldado. Ex: tatico set_id x", cmd_set_id),
    SHELL_SUBCMD_SET_END /* Terminador obrigatório!! */
);
SHELL_CMD_REGISTER(tatico, &sub_tatico, "Comandos do dispositivo tático", NULL);
```

## src/tatico_shell.h
```c
#ifndef TATICO_SHELL_H
#define TATICO_SHELL_H

/* * O subsistema de shell do Zephyr usa macros para auto-registrar os comandos
 * em tempo de compilação. Portanto, não precisamos exportar funções públicas aqui.
 * Este arquivo existe para manter o padrão de arquitetura.
 */

#endif /* TATICO_SHELL_H */
```
